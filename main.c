#include<reg51.h>	//加载头文件
#include<intrins.h>
#define uint unsigned int 	//宏定义
#define uchar unsigned char
sbit DS=P2^4;	//595接口位定义
sbit SHCP=P2^5;
sbit STCP=P2^6;
uchar code TAB[][128]={		


0xFF,0xFF,0xFF,0xFF,0xFF,0xFF,0xFF,0xFF,
0xFF,0xFF,0xDF,0xFF,0xFF,0xEF,0x1F,0xFF,
0x07,0xC0,0x9F,0xFF,0xFF,0xC7,0x9F,0xFF,
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0xFF,0xFF,0xFF,0xFF,0xFF,0xFF,0xFF,0xFF,/*"C:\Users\18249\Desktop\1111.bmp",0*/

};
void Delay(uint z) 	//延时函数
{
	uint x,y;
	for(x=z;x>0;x--)
		for(y=30;y>0;y--);
}
void HC595_Send_Byte(uchar temp) //发送数据
{
	uchar c;
	for(c=0;c<8;c++)
	{
		temp=temp>>1; 
		DS=CY ;
		SHCP=1 ; //上升沿发生移位
		_nop_() ;
		_nop_() ;
		SHCP=0 ;
	}
}
void main()	//主函数
{
	uchar j,k;	//变量声明
	uchar n;
	while(1) 	//大循环
	{
	  	for(n=0;n<4;n++)	//总共显示的字数
		{
			for(k=0;k<60;k++)	//显示的时间调节
			{
				for(j=0;j<32;j++)	//显示的汉字点阵数
				{
					HC595_Send_Byte(TAB[n][j*4]);	//传输数据
					HC595_Send_Byte(TAB[n][j*4+1]); 
					HC595_Send_Byte(TAB[n][j*4+2]);
					HC595_Send_Byte(TAB[n][j*4+3]);
					P1=j;
					STCP=1;
					STCP=0;
				}
				Delay(1);
			}
		}
	}
}